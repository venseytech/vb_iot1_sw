## 01_IMX_Buildroot/buildroot/package/v_apps/Config.in
```kconfig
menuconfig BR2_PACKAGE_V_APPS
	bool "VeNSeY Applications Software"
	help
		VeNSeY Applications are divided into two groups, namely, the platform & application
		http://www.vensey.de

	if BR2_PACKAGE_V_APPS
		menu "VeNSeY Application Software"
			source package/v_apps/vensey_test_c/Config.in
			source package/v_apps/vensey_test_jdk/Config.in
		endmenu
	endif

comment "@2017 All Rights Reserved to VeNSeY"
```

## 01_IMX_Buildroot/buildroot/package/v_apps/vensey_test_c/Config.in
```kconfig
config BR2_PACKAGE_VENSEY_TEST_C
	bool "vensey_test_c"
	help
		Example hello world application in C
		http://www.vensey.de
```

## 01_IMX_Buildroot/buildroot/package/v_apps/vensey_test_jdk/Config.in
```kconfig
config BR2_PACKAGE_VENSEY_TEST_JDK
	bool "vensey_test_jdk"
	help
		Example application provided for Java applications
	 	http://www.vensey.de
```

## 01_IMX_Buildroot/buildroot/package/v_opensource/Config.in
```kconfig
menuconfig BR2_PACKAGE_V_OPENSOURCE
	bool "Open Source Software"
	help
	  VeNSeY software to be released or the open source utilities 
	  used different than the buildroot environment are stored here.  

	  http://www.vensey.de

	
	if BR2_PACKAGE_V_OPENSOURCE
		menu "Required Open Source Packages"
			source package/v_opensource/rxtx/Config.in
			source package/v_opensource/oracle_jdk/Config.in 
		endmenu
	endif
```

## 01_IMX_Buildroot/buildroot/package/v_opensource/oracle_jdk/Config.in
```kconfig
config BR2_PACKAGE_ORACLE_JDK
	bool "oraclejdk"
	help
		http://www.oracle.com/technetwork/java/embedded/embedded-se/downloads/index.html
```

## 01_IMX_Buildroot/buildroot/package/v_opensource/rxtx/Config.in
```kconfig
config BR2_PACKAGE_RXTX
	bool "rxtx"
	depends on BR2_PACKAGE_ORACLE_JDK
	help
	  rxtx is the java libraries for serial communication over RS232

	  http://rxtx.qbang.org/pub/rxtx
```

## 01_IMX_Buildroot/buildroot/package/v_platform/Config.in
```kconfig
menuconfig BR2_PACKAGE_V_PLATFORM
	bool "VeNSeY Platform Software"
	help
	  VeNSeY Applications are divided into two groups, namely, the platform & application
	  http://www.vensey.de
	
	if BR2_PACKAGE_V_PLATFORM
		menu "VeNSeY Platfrom Software"
			source package/v_platform/vensey_fs/Config.in
			source package/v_platform/vensey_pm/Config.in
			source package/v_platform/internal_temperature/Config.in
		endmenu
	endif


comment "Notes for the Liscencing..."
```

## 01_IMX_Buildroot/buildroot/package/v_platform/internal_temperature/Config.in
```kconfig
config BR2_PACKAGE_INTERNAL_TEMPERATURE
	bool "internal_temperature"
	help
	  internal_temperature is an example application for reading CPU internal temperature
```

## 01_IMX_Buildroot/buildroot/package/v_platform/vensey_fs/Config.in
```kconfig
config BR2_PACKAGE_VENSEY_FS
	bool "vensey_fs"
	help
	  vensey_fs is the bunc of files to be copied to the root file system for configuration, etc.

	  http://www.vensey.de
```

## 01_IMX_Buildroot/buildroot/package/v_platform/vensey_pm/Config.in
```kconfig
config BR2_PACKAGE_VENSEY_PM
	bool "vensey_pm"
	help
	  vensey_pm is the kernel module for different power management options and related configurations from the user space
```
